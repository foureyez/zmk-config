## boards/shields/shields/dactyl_tracer/Kconfig.defconfig
```kconfig
if SHIELD_DACTYL_TRACER_LEFT
  
config ZMK_KEYBOARD_NAME 
    default "Dactyl Tracer"

config ZMK_SPLIT_ROLE_CENTRAL
    default y
endif


if SHIELD_DACTYL_TRACER_LEFT || SHIELD_DACTYL_TRACER_RIGHT


config ZMK_SPLIT
    default y

endif

config ZMK_SLEEP
    default y
config ZMK_STUDIO
    default y
```

## boards/shields/shields/dactyl_tracer/Kconfig.shield
```kconfig
config SHIELD_DACTYL_TRACER_LEFT 
    def_bool $(shields_list_contains,dactyl_tracer_left)

config SHIELD_DACTYLTRACER_RIGHT 
    def_bool $(shields_list_contains,dactyl_tracer_right)
```
